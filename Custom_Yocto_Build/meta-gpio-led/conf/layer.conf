## Custom_Yocto_Build/meta-gpio-led/conf/layer.conf
```bitbake
# We have a conf and classes directory, add to BBPATH
BBPATH .= ":${LAYERDIR}"

# We have recipes-* directories, add to BBFILES
BBFILES += "${LAYERDIR}/recipes-*/*/*.bb \
            ${LAYERDIR}/recipes-*/*/*.bbappend"

BBFILE_COLLECTIONS += "meta-gpio-led"
BBFILE_PATTERN_meta-gpio-led = "^${LAYERDIR}/"
BBFILE_PRIORITY_meta-gpio-led = "6"

LAYERDEPENDS_meta-gpio-led = "core"
LAYERSERIES_COMPAT_meta-gpio-led = "kirkstone"
```

## Custom_Yocto_Build/meta-mmagdi-distro/conf/distro/mmagdi.conf
```bitbake
DISTRO = "mmagdi"
DISTRO_NAME = "mmagdi (A custom distro for me)"
DISTRO_VERSION = "1.0.0"
DISTRO_CODENAME = "kirkstone"

MAINTAINER = "Mohamed Magdi <github: https://github.com/Mo-Alsehli>"

#TARGET_VENDOR = "-raspberry-pi-3b"
TARGET_VENDOR = "-rpi3b"

########################### POKY DEFAULTS ################################################
##########################################################################################
DISTRO_CODENAME = "kirkstone"
SDK_VENDOR = "-pokysdk"
SDK_VERSION = "${@d.getVar('DISTRO_VERSION').replace('snapshot-${METADATA_REVISION}', 'snapshot')}"
SDK_VERSION[vardepvalue] = "${SDK_VERSION}"


LOCALCONF_VERSION = "2"

# Override these in poky based distros
POKY_DEFAULT_DISTRO_FEATURES = "largefile opengl ptest multiarch wayland vulkan"
POKY_DEFAULT_EXTRA_RDEPENDS = "packagegroup-core-boot"
POKY_DEFAULT_EXTRA_RRECOMMENDS = "kernel-module-af-packet"

DISTRO_FEATURES ?= "${DISTRO_FEATURES_DEFAULT} ${POKY_DEFAULT_DISTRO_FEATURES}"

PREFERRED_VERSION_linux-yocto ?= "5.15%"
PREFERRED_VERSION_linux-yocto-rt ?= "5.15%"

SDK_NAME = "${DISTRO}-${TCLIBC}-${SDKMACHINE}-${IMAGE_BASENAME}-${TUNE_PKGARCH}-${MACHINE}"
SDKPATHINSTALL = "/opt/${DISTRO}/${SDK_VERSION}"

DISTRO_EXTRA_RDEPENDS += "${POKY_DEFAULT_EXTRA_RDEPENDS}"
DISTRO_EXTRA_RRECOMMENDS += "${POKY_DEFAULT_EXTRA_RRECOMMENDS}"

TCLIBCAPPEND = ""

SANITY_TESTED_DISTROS ?= " \
            poky-3.3 \n \
            poky-3.4 \n \
            ubuntu-18.04 \n \
            ubuntu-20.04 \n \
            ubuntu-22.04 \n \
            ubuntu-24.04 \n \
            fedora-37 \n \
            fedora-39 \n \
            fedora-40 \n \
            debian-11 \n \
            opensuseleap-15.3 \n \
            almalinux-8.8 \n \
            almalinux-8.9 \n \
            almalinux-8.10 \n \
            almalinux-9.4 \n \
            "
# add poky sanity bbclass
INHERIT += "poky-sanity"

# QA check settings - a little stricter than the OE-Core defaults
# (none currently necessary as we now match OE-Core)
#WARN_TO_ERROR_QA = "X"
#WARN_QA_remove = "${WARN_TO_ERROR_QA}"
#ERROR_QA_append = " ${WARN_TO_ERROR_QA}"

require conf/distro/include/poky-world-exclude.inc
require conf/distro/include/no-static-libs.inc
require conf/distro/include/yocto-uninative.inc
require conf/distro/include/security_flags.inc
INHERIT += "uninative"

BB_SIGNATURE_HANDLER ?= "OEEquivHash"
BB_HASHSERVE ??= "auto"

######################################################################################
# tell it to give the .wic directly
IMAGE_FSTYPES = "wic wic.bmap"


# Init Manager and backfill compatibilty.
VIRTUAL-RUNTIME_init_manager = "systemd"
DISTRO_FEATURES_BACKFILL_CONSIDERED:append = " sysvinit"
VIRTUAL-RUNTIME_initscripts = "systemd-compat-units"

# Distro Features.
DISTRO_FEATURES:append = " pam systemd wifi"

# Remove uneeded 
IMAGE_FEATURES:remove = "ssh-server-dropbear"
# Image Install apps
IMAGE_INSTALL:append = " python3 bash tcpdump gpioled openssh tictactoe wifi-config rdp-certs"
#IMAGE_INSTALL:remove = " weston-xwayland"

EXTRA_IMAGE_FEATURES ?= "debug-tweaks ssh-server-openssh"

# Enable UART for tty
ENABLE_UART = "1"
SERIAL_CONSOLES = "115200;ttyS0"

# Configure gpio17 as pull-up
RPI_EXTRA_CONFIG:append = " gpio=17=ip,pu"
```

## Custom_Yocto_Build/meta-mmagdi-distro/conf/layer.conf
```bitbake
# We have a conf and classes directory, add to BBPATH
BBPATH .= ":${LAYERDIR}"

# We have recipes-* directories, add to BBFILES
BBFILES += "${LAYERDIR}/recipes-*/*/*.bb \
            ${LAYERDIR}/recipes-*/*/*.bbappend"

BBFILE_COLLECTIONS += "meta-mmagdi-distro"
BBFILE_PATTERN_meta-mmagdi-distro = "^${LAYERDIR}/"
BBFILE_PRIORITY_meta-mmagdi-distro = "6"

LAYERDEPENDS_meta-mmagdi-distro = "core"
LAYERSERIES_COMPAT_meta-mmagdi-distro = "kirkstone"
```
